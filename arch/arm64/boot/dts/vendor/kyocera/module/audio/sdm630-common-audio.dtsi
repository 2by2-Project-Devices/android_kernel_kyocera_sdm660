/*
 * This software is contributed or developed by KYOCERA Corporation.
 * (C) 2019 KYOCERA Corporation
 *
 * This program is free software; you can redistribute it and/or modify
 * it under the terms of the GNU General Public License version 2 and
 * only version 2 as published by the Free Software Foundation.
 *
 * This program is distributed in the hope that it will be useful,
 * but WITHOUT ANY WARRANTY; without even the implied warranty of
 * MERCHANTABILITY or FITNESS FOR A PARTICULAR PURPOSE.  See the
 * GNU General Public License for more details.
 */

&soc {
	int_codec: sound {
                qcom,model = "sdm660-snd-card-mtp";
		qcom,msm-mbhc-hphl-swh = <1>;
		qcom,msm-mbhc-gnd-swh = <1>;

		qcom,wsa-disable;
		qcom,wsa-max-devs = <0>;
		qcom,msm-hs-micbias-type = "internal";
		/delete-property/ qcom,wsa-devs;
		/delete-property/ qcom,wsa-aux-dev-prefix;

		/delete-property/ qcom,ext-disp-audio-rx;
		/delete-property/ qcom,msm-micbias2-ext-cap;
		/delete-property/ qcom,us-euro-gpios;


		qcom,audio-routing =
			"RX_BIAS", "INT_MCLK0",
			"SPK_RX_BIAS", "INT_MCLK0",
			"INT_LDO_H", "INT_MCLK0",
			"MIC BIAS External2", "Headset Mic",
			"AMIC2", "MIC BIAS External2",
			"DMIC1", "MIC BIAS External",
			"MIC BIAS External", "Digital Mic1",
			"DMIC2", "MIC BIAS External",
			"MIC BIAS External", "Digital Mic2",
			"DMIC3", "MIC BIAS External",
			"MIC BIAS External", "Digital Mic3",
			"PDM_IN_RX1", "PDM_OUT_RX1",
			"PDM_IN_RX2", "PDM_OUT_RX2",
			"ADC2_IN", "ADC2_OUT";
		asoc-codec = <&stub_codec>, <&msm_digital_codec>,
			<&pmic_analog_codec>,<&ext_disp_audio_codec>;
		asoc-codec-names = "msm-stub-codec.1", "msm-dig-codec",
			"analog-codec", "msm-ext-disp-audio-codec-rx";
	};
		/delete-node/ msm-sdw-codec@152c1000;
		/delete-node/ sdw_clk_data_pinctrl;
		/delete-node/ wsa_spkr_en1_pinctrl;
		/delete-node/ wsa_spkr_en2_pinctrl;
};

