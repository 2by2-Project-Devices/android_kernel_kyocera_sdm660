/*
 * This software is contributed or developed by KYOCERA Corporation.
 * (C) 2018 KYOCERA Corporation
 *
 * This program is free software; you can redistribute it and/or modify
 * it under the terms of the GNU General Public License version 2 and
 * only version 2 as published by the Free Software Foundation.
 *
 * This program is distributed in the hope that it will be useful,
 * but WITHOUT ANY WARRANTY; without even the implied warranty of
 * MERCHANTABILITY or FITNESS FOR A PARTICULAR PURPOSE.  See the
 * GNU General Public License for more details.
 */




&i2c_4 {
	pinctrl-names = "i2c_active", "i2c_sleep", "i2c_default";
	pinctrl-0 = <&i2c_4_active>;
	pinctrl-1 = <&i2c_4_sleep>;
	pinctrl-2 = <&i2c_4_default>;
};

&spi_1 {
	pinctrl-0 = <&spi_dtv_micon_mosi_active
	             &spi_dtv_micon_miso_active
	             &spi_dtv_cs_n_active
	             &spi_dtv_micon_clk_active
	             &spi_micon_cs_active>;
	pinctrl-1 = <&spi_dtv_micon_mosi_suspend
	             &spi_dtv_micon_miso_suspend
	             &spi_dtv_cs_n_suspend
	             &spi_dtv_micon_clk_suspend
	             &spi_micon_cs_suspend>;
};
