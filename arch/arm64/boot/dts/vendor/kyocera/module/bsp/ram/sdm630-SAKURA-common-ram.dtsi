/*
 * This software is contributed or developed by KYOCERA Corporation.
 * (C) 2018 KYOCERA Corporation
 *
 * This program is free software; you can redistribute it and/or modify
 * it under the terms of the GNU General Public License version 2 and
 * only version 2 as published by the Free Software Foundation.
 *
 * This program is distributed in the hope that it will be useful,
 * but WITHOUT ANY WARRANTY; without even the implied warranty of
 * MERCHANTABILITY or FITNESS FOR A PARTICULAR PURPOSE.  See the
 * GNU General Public License for more details.
 */

/ {
	reserved-memory {
		uninit_ram_mem: uninit_ram_region@ffc00000 {
			compatible = "removed-dma-pool";
			no-map;
			reg = <0x0 0xa0200000 0x0 0x400000>;
		};

		ramoops_mem: ramoops@85500000 {
			compatible = "ramoops";
			reg = <0x0 0x85500000 0x0 0x100000>;
			record-size = <0x20000>;
			console-size = <0x40000>;
			pmsg-size = <0x20000>;
		};
	};
};
