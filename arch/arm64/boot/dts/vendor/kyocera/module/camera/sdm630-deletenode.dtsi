/*
 * This software is contributed or developed by KYOCERA Corporation.
 * (C) 2018 KYOCERA Corporation
 *
 * This program is free software; you can redistribute it and/or modify
 * it under the terms of the GNU General Public License version 2 and
 * only version 2 as published by the Free Software Foundation.
 *
 * This program is distributed in the hope that it will be useful,
 * but WITHOUT ANY WARRANTY; without even the implied warranty of
 * MERCHANTABILITY or FITNESS FOR A PARTICULAR PURPOSE.  See the
 * GNU General Public License for more details.
 */

&soc {
	/delete-node/ qcom,camera-flash@0;
	/delete-node/ qcom,camera-flash@1;
	/delete-node/ cam_avdd_fixed_regulator;
	/delete-node/ cam_dvdd_fixed_regulator;
	/delete-node/ cam_rear_dvdd_fixed_regulator;

	tlmm: pinctrl@03000000 {
		/delete-node/ cci0_active;
		/delete-node/ cci0_suspend;
		/delete-node/ cci1_active;
		/delete-node/ cci1_suspend;
		/delete-node/ cam_actuator_vaf_active;
		/delete-node/ cam_actuator_vaf_suspend;
		/delete-node/ cam_sensor_mclk0_active;
		/delete-node/ cam_sensor_mclk0_suspend;
		/delete-node/ cam_sensor_rear_active;
		/delete-node/ cam_sensor_rear_suspend;
		/delete-node/ cam_sensor_mclk1_active;
		/delete-node/ cam_sensor_mclk1_suspend;
		/delete-node/ cam_sensor_rear2_active;
		/delete-node/ cam_sensor_rear2_suspend;
		/delete-node/ cam_sensor_mclk2_active;
		/delete-node/ cam_sensor_mclk2_suspend;
		/delete-node/ cam_sensor_front_active;
		/delete-node/ cam_sensor_front_suspend;
		/delete-node/ cam_sensor_mclk3_active;
		/delete-node/ cam_sensor_mclk3_suspend;
		/delete-node/ cam_sensor_front_iris_active;
		/delete-node/ cam_sensor_front_iris_suspend;
        };
};

&cci {
	/delete-node/ qcom,actuator@0;
	/delete-node/ qcom,actuator@1;
	/delete-node/ qcom,actuator@2;
	/delete-node/ qcom,ois@0;
	/delete-node/ qcom,eeprom@0;
	/delete-node/ qcom,eeprom@1;
	/delete-node/ qcom,eeprom@2;
	/delete-node/ qcom,camera@0;
	/delete-node/ qcom,camera@1;
	/delete-node/ qcom,camera@2;
	/delete-node/ qcom,camera@3;
};

