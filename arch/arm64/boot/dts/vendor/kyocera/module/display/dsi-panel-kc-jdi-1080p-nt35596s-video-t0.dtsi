/* Copyright (c) 2017, The Linux Foundation. All rights reserved.
 *
 * This program is free software; you can redistribute it and/or modify
 * it under the terms of the GNU General Public License version 2 and
 * only version 2 as published by the Free Software Foundation.
 *
 * This program is distributed in the hope that it will be useful,
 * but WITHOUT ANY WARRANTY; without even the implied warranty of
 * MERCHANTABILITY or FITNESS FOR A PARTICULAR PURPOSE.  See the
 * GNU General Public License for more details.
 */
/*
 * This software is contributed or developed by KYOCERA Corporation.
 * (C) 2018 KYOCERA Corporation
 */

&mdss_mdp {
	dsi_kc_jdi_1080_video: qcom,mdss_dsi_kc_jdi_1080p_video {
		qcom,mdss-dsi-panel-name = "kc jdi 1080p video mode dsi panel";
		qcom,mdss-dsi-panel-type = "dsi_video_mode";
		qcom,mdss-dsi-panel-framerate = <60>;
		qcom,mdss-dsi-virtual-channel-id = <0>;
		qcom,mdss-dsi-stream = <0>;
		qcom,mdss-dsi-panel-width = <1080>;
		qcom,mdss-dsi-panel-height = <1920>;
		qcom,mdss-dsi-h-front-porch = <24>;
		qcom,mdss-dsi-h-back-porch = <76>;
		qcom,mdss-dsi-h-pulse-width = <24>;
		qcom,mdss-dsi-h-sync-skew = <0>;
		qcom,mdss-dsi-v-back-porch = <3>;
		qcom,mdss-dsi-v-front-porch = <4>;
		qcom,mdss-dsi-v-pulse-width = <1>;
		qcom,mdss-dsi-h-left-border = <0>;
		qcom,mdss-dsi-h-right-border = <0>;
		qcom,mdss-dsi-v-top-border = <0>;
		qcom,mdss-dsi-v-bottom-border = <0>;
		qcom,mdss-dsi-bpp = <24>;
		qcom,mdss-dsi-underflow-color = <0xff>;
		qcom,mdss-dsi-border-color = <0>;
		qcom,mdss-dsi-h-sync-pulse = <0>;
		qcom,mdss-dsi-traffic-mode = "non_burst_sync_event";
		qcom,mdss-dsi-bllp-eof-power-mode;
		qcom,mdss-dsi-bllp-power-mode;
		qcom,mdss-dsi-lane-0-state;
		qcom,mdss-dsi-lane-1-state;
		qcom,mdss-dsi-lane-2-state;
		qcom,mdss-dsi-lane-3-state;
		qcom,mdss-dsi-panel-timings = [
			00 1D 07 07 23 22 07
			07 05 03 04 00
		];
		qcom,mdss-dsi-panel-timings-phy-v2 = [
			23 1f 07 09 05 03 04 a0
			23 1f 07 09 05 03 04 a0
			23 1f 07 09 05 03 04 a0
			23 1f 07 09 05 03 04 a0
			23 19 07 08 05 03 04 a0
		];
		qcom,mdss-dsi-t-clk-post = <0x0d>;
		qcom,mdss-dsi-t-clk-pre = <0x2d>;
		qcom,mdss-dsi-bl-min-level = <1>;
		qcom,mdss-dsi-bl-max-level = <4095>;
		qcom,mdss-dsi-dma-trigger = "trigger_sw";
		qcom,mdss-dsi-mdp-trigger = "none";
		qcom,mdss-dsi-on-command = [
			15 01 00 00 00 00 02 FF 22
			15 01 00 00 00 00 02 1A 00
			15 01 00 00 00 00 02 53 00
			15 01 00 00 00 00 02 56 77
			15 01 00 00 00 00 02 58 77
			15 01 00 00 00 00 02 59 12
			15 01 00 00 00 00 02 5F 12
			15 01 00 00 00 00 02 68 00
			15 01 00 00 00 00 02 6B 55
			15 01 00 00 00 00 02 6C E4
			15 01 00 00 00 00 02 6D 20
			15 01 00 00 00 00 02 A2 20
			15 01 00 00 00 00 02 A9 00
			15 01 00 00 00 00 02 FB 01
			15 01 00 00 00 00 02 FF 10

			15 01 00 00 00 00 02 35 01
			15 01 00 00 00 00 02 51 FF
			15 01 00 00 00 00 02 53 24
			15 01 00 00 00 00 02 55 01
			15 01 00 00 28 00 02 B0 00
			15 01 00 00 00 00 02 35 00
			05 01 00 00 78 00 01 11
		];
		qcom,mdss-dsi-post-panel-on-command = [
			05 01 00 00 14 00 01 29
		];
		qcom,mdss-dsi-off-command = [
			05 01 00 00 14 00 01 28
			05 01 00 00 7D 00 01 10
		];
		qcom,mdss-dsi-on-command-state = "dsi_lp_mode";
		qcom,mdss-dsi-on-post-command-state = "dsi_hs_mode";
		qcom,mdss-dsi-off-command-state = "dsi_hs_mode";
//		qcom,mdss-dsi-bl-pmic-control-type = "bl_ctrl_wled";
		qcom,mdss-dsi-reset-sequence = <1 11>, <0 11>, <1 11>;
		qcom,mdss-dsi-tx-eot-append;
		qcom,mdss-dsi-post-init-delay = <1>;
		qcom,mdss-pan-physical-width-dimension = <62>;
		qcom,mdss-pan-physical-height-dimension = <110>;
		qcom,suspend-ulps-enabled;
		qcom,mdss-dsi-lp11-init;
		qcom,esd-check-enabled;
		qcom,mdss-dsi-panel-status-check-mode = "reg_read";
		qcom,mdss-dsi-panel-status-command-state = "dsi_hs_mode";
		qcom,mdss-dsi-panel-status-command = [
			06 01 00 01 05 00 01 0A
			06 01 00 01 05 00 01 ED
		];
		qcom,mdss-dsi-panel-status-read-length = <1 1>;
		qcom,mdss-dsi-panel-status-value = <0x9C 0x00>;

		kc,panel-detect-enabled;
		kc,tp-incell-enabled;
		kc,tp-type = "cyttsp5";

//		kc,dsi-freq-mode-en;
		kc,dsi-freq-mode-default = <0>;

		//mode0
		kc,dsi-freq-j-h-front-porch = <24>;
		kc,dsi-freq-j-h-back-porch = <76>;
		kc,dsi-freq-j-h-pulse-width = <24>;
		kc,dsi-freq-j-v-back-porch = <3>;
		kc,dsi-freq-j-v-front-porch = <4>;
		kc,dsi-freq-j-v-pulse-width = <1>;

		kc,dsi-freq-j-panel-timings-phy-v2 = [
			23 1f 07 09 05 03 04 a0
			23 1f 07 09 05 03 04 a0
			23 1f 07 09 05 03 04 a0
			23 1f 07 09 05 03 04 a0
			23 19 07 08 05 03 04 a0
		];

		kc,dsi-freq-j-t-clk-post = <0x0d>;
		kc,dsi-freq-j-t-clk-pre = <0x2d>;

		//mode1
		kc,dsi-freq-u-h-front-porch = <24>;
		kc,dsi-freq-u-h-back-porch = <76>;
		kc,dsi-freq-u-h-pulse-width = <24>;
		kc,dsi-freq-u-v-back-porch = <3>;
		kc,dsi-freq-u-v-front-porch = <4>;
		kc,dsi-freq-u-v-pulse-width = <1>;

		kc,dsi-freq-u-panel-timings-phy-v2 = [
			23 1f 07 09 05 03 04 a0
			23 1f 07 09 05 03 04 a0
			23 1f 07 09 05 03 04 a0
			23 1f 07 09 05 03 04 a0
			23 19 07 08 05 03 04 a0
		];

		kc,dsi-freq-u-t-clk-post = <0x0d>;
		kc,dsi-freq-u-t-clk-pre = <0x2d>;

		//mode2
		kc,dsi-freq-e-h-front-porch = <24>;
		kc,dsi-freq-e-h-back-porch = <76>;
		kc,dsi-freq-e-h-pulse-width = <24>;
		kc,dsi-freq-e-v-back-porch = <3>;
		kc,dsi-freq-e-v-front-porch = <4>;
		kc,dsi-freq-e-v-pulse-width = <1>;

		kc,dsi-freq-e-panel-timings-phy-v2 = [
			23 1f 07 09 05 03 04 a0
			23 1f 07 09 05 03 04 a0
			23 1f 07 09 05 03 04 a0
			23 1f 07 09 05 03 04 a0
			23 19 07 08 05 03 04 a0
		];

		kc,dsi-freq-e-t-clk-post = <0x0d>;
		kc,dsi-freq-e-t-clk-pre = <0x2d>;
		kc,easywake-mode-enabled;

		kc,sre-mode-strong-command = [
			15 01 00 00 00 00 02 FF 10
			15 01 00 00 00 00 02 55 80
		];
		kc,sre-mode-medium-command = [
			15 01 00 00 00 00 02 FF 10
			15 01 00 00 00 00 02 55 80
		];
		kc,sre-mode-weak-command = [
			15 01 00 00 00 00 02 FF 10
			15 01 00 00 00 00 02 55 80
		];
		kc,sre-mode-off-command = [
			15 01 00 00 00 00 02 FF 10
			15 01 00 00 00 00 02 55 01
		];
		kc,sre-mode-command-state = "dsi_hs_mode";
		kc,sre-mode-max = <3>;
		kc,sre-mode-enabled;
	};
};
