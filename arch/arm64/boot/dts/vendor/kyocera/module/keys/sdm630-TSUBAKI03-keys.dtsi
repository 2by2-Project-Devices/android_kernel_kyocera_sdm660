/*
 * This software is contributed or developed by KYOCERA Corporation.
 * (C) 2019 KYOCERA Corporation
 *
 * This program is free software; you can redistribute it and/or modify
 * it under the terms of the GNU General Public License version 2 and
 * only version 2 as published by the Free Software Foundation.
 *
 * This program is distributed in the hope that it will be useful,
 * but WITHOUT ANY WARRANTY; without even the implied warranty of
 * MERCHANTABILITY or FITNESS FOR A PARTICULAR PURPOSE.  See the
 * GNU General Public License for more details.
 */

&soc {
        gpio_keys {
                camera_key {
                        label = "camera_key";
                        gpios = <&pm660l_gpios 4 0x1>;
                        linux,input-type = <1>;
                        linux,code = <212>;
                        gpio-key,wakeup;
                        debounce-interval = <20>;
                        on_chattering_num  = <1>;
                        off_chattering_num = <0>;
                };

                ptt_key {
                        label = "ptt_key";
                        gpios = <&pm660l_gpios 5 0x1>;
                        linux,input-type = <1>;
                        linux,code = <231>;
                        gpio-key,wakeup;
                        debounce-interval = <20>;
                        on_chattering_num  = <1>;
                        off_chattering_num = <0>;
                };
        };
};

