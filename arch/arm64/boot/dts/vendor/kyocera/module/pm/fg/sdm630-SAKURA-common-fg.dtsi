/*
 * This software is contributed or developed by KYOCERA Corporation.
 * (C) 2018 KYOCERA Corporation
 *
 * This program is free software; you can redistribute it and/or modify
 * it under the terms of the GNU General Public License version 2 and
 * only version 2 as published by the Free Software Foundation.
 *
 * This program is distributed in the hope that it will be useful,
 * but WITHOUT ANY WARRANTY; without even the implied warranty of
 * MERCHANTABILITY or FITNESS FOR A PARTICULAR PURPOSE.  See the
 * GNU General Public License for more details.
 */

&pm660_fg {
	qcom,fg-force-load-profile;
	qcom,rradc-base = <0x4500>;

	qcom,cycle-counter-en;
	qcom,cl-max-decrement = <100>;
	qcom,cl-max-increment = <5>;
	qcom,cl-max-limit = <0>;
	qcom,cl-max-temp = <420>;
	qcom,cl-min-limit = <0>;
	qcom,cl-min-temp = <150>;
	qcom,cl-start-capacity = <40>;

	qcom,fg-batt-temp-delta = <2>;

	qcom,fg-esr-timer-asleep = <256 256>;
	qcom,fg-esr-timer-awake = <96 96>;
	qcom,fg-esr-timer-charging = <0 96>;

	qcom,fg-delta-soc-thr = <0>;

	qcom,cycle-counter-en;
};


