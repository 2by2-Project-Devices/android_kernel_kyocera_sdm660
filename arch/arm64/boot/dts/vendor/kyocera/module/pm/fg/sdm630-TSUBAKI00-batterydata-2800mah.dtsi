/*
 * This software is contributed or developed by KYOCERA Corporation.
 * (C) 2018 KYOCERA Corporation
 * (C) 2019 KYOCERA Corporation
 *
 * This program is free software; you can redistribute it and/or modify
 * it under the terms of the GNU General Public License version 2 and
 * only version 2 as published by the Free Software Foundation.
 *
 * This program is distributed in the hope that it will be useful,
 * but WITHOUT ANY WARRANTY; without even the implied warranty of
 * MERCHANTABILITY or FITNESS FOR A PARTICULAR PURPOSE.  See the
 * GNU General Public License for more details.
 */


qcom,sdm630-sakura-batterydata {
	/* #3054923_SDM630A1_2800mAh_Aug31st2017*/
	qcom,max-voltage-uv = <4305000>;
	qcom,fg-cc-cv-threshold-mv = <4295>;
	oem,fg-cc-cv-cool-threshold-mv = <4145>;
	oem,fg-cc-cv-warm-threshold-mv = <4145>;
	oem,cycle-count-thresh-first = <200>;
	oem,cycle-count-thresh-second = <500>;
	oem,cycle-count-voltage-comp-first-mv = <50>;
	oem,cycle-count-voltage-comp-second-mv = <100>;
	oem,cycle-count-cc-cv-comp-first-mv = <50>;
	oem,cycle-count-cc-cv-comp-second-mv = <100>;
	oem,cont-chg-thresh-first = <52000>;
	oem,cont-chg-thresh-second = <104000>;
	oem,cont-chg-voltage-comp-first-mv = <50>;
	oem,cont-chg-voltage-comp-second-mv = <100>;
	oem,cont-chg-cc-cv-comp-first-mv = <50>;
	oem,cont-chg-cc-cv-comp-second-mv = <100>;
	oem,cont-chg-factor = <3 4 5 8 11 15 22 32 46>;
	oem,deterioration-thresh-good = <75>;
	oem,deterioration-thresh-norm = <50>;
	oem,deterioration-thresh-normtogood = <85>;
	oem,deterioration-thresh-deadtonorm = <60>;
	qcom,fastchg-current-ma = <2400>;
	qcom,nom-batt-capacity-mah = <3240>;
	qcom,batt-id-kohm = <100>;
	qcom,battery-beta = <4050>;
	qcom,battery-type = "sdm630-sakura-batterydata";
	qcom,checksum = <0x1D9C>;
	qcom,gui-version = "PM660GUI - 0.0.0.44";
	qcom,fg-profile-data = [
		 66 1F EB 05
		 0D 0A 53 FD
		 6B 1D FF EC
		 51 0B 42 15
		 95 18 BD 22
		 EF 45 1A 52
		 5B 00 00 00
		 0E 00 00 00
		 00 00 FC 07
		 AD BC 89 BB
		 1B 00 08 00
		 66 D3 EE E4
		 6E F4 81 EA
		 3E F2 7A 0A
		 6C 0C 18 52
		 0A 06 09 20
		 27 00 14 00
		 9E 1F E0 05
		 04 0A 79 FD
		 3A 1D 15 FA
		 21 FA A7 0D
		 36 19 C7 22
		 A0 45 C1 52
		 59 00 00 00
		 0D 00 00 00
		 00 00 82 CC
		 6F BB B7 C3
		 19 00 00 00
		 A6 EA EE E4
		 CA F4 29 EA
		 53 F2 EE 03
		 EC 04 A0 1A
		 9E 33 CC FF
		 07 10 00 00
		 CA 0A CC 44
		 19 00 40 00
		 A5 01 0A FA
		 FF 00 00 00
		 00 00 00 00
		 00 00 00 00
		 00 00 00 00
		 00 00 00 00
		 00 00 00 00
		 00 00 00 00
		 00 00 00 00
		 00 00 00 00
		 00 00 00 00
		 00 00 00 00
		 00 00 00 00
		 00 00 00 00
		 00 00 00 00
		 00 00 00 00
		 00 00 00 00
		 00 00 00 00
		 00 00 00 00
		 00 00 00 00
	];
};
