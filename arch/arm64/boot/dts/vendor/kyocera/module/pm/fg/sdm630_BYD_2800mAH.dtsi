/*
 * This software is contributed or developed by KYOCERA Corporation.
 * (C) 2018 KYOCERA Corporation
 * (C) 2019 KYOCERA Corporation
 *
 * This program is free software; you can redistribute it and/or modify
 * it under the terms of the GNU General Public License version 2 and
 * only version 2 as published by the Free Software Foundation.
 *
 * This program is distributed in the hope that it will be useful,
 * but WITHOUT ANY WARRANTY; without even the implied warranty of
 * MERCHANTABILITY or FITNESS FOR A PARTICULAR PURPOSE.  See the
 * GNU General Public License for more details.
 */

qcom,byd_2800mah {
	qcom, = <24>;
	/* #3567959_BYD_KC-MID_BYD_2800mAH_averaged_MasterSlave_Aug16th2018*/
	qcom,max-voltage-uv = <4350000>;
	qcom,fg-cc-cv-threshold-mv = <4340>;
	oem,fg-cc-cv-cool-threshold-mv = <4093>;
	oem,fg-cc-cv-warm-threshold-mv = <4093>;
	oem,cycle-count-thresh-first = <200>;
	oem,cycle-count-thresh-second = <500>;
	oem,cycle-count-voltage-comp-first-mv = <50>;
	oem,cycle-count-voltage-comp-second-mv = <100>;
	oem,cycle-count-cc-cv-comp-first-mv = <50>;
	oem,cycle-count-cc-cv-comp-second-mv = <100>;
	oem,cont-chg-thresh-first = <52000>;
	oem,cont-chg-thresh-second = <104000>;
	oem,cont-chg-voltage-comp-first-mv = <50>;
	oem,cont-chg-voltage-comp-second-mv = <100>;
	oem,cont-chg-cc-cv-comp-first-mv = <50>;
	oem,cont-chg-cc-cv-comp-second-mv = <100>;
	oem,cont-chg-factor = <3 4 5 8 11 15 22 32 46>;
	oem,deterioration-thresh-good = <75>;
	oem,deterioration-thresh-norm = <50>;
	oem,deterioration-thresh-normtogood = <85>;
	oem,deterioration-thresh-deadtonorm = <60>;
	qcom,fastchg-current-ma = <1800>;
	qcom,nom-batt-capacity-mah = <2800>;
	qcom,batt-id-kohm = <10>;
	qcom,battery-beta = <3380>;
	qcom,battery-type = "sdm630-sakura-batterydata";
	qcom,checksum = <0x5DF9>;
	qcom,gui-version = "PM660GUI - 0.0.0.45";
	qcom,fg-profile-data = [
		 74 1F D6 05
		 22 0A 67 FD
		 E3 1C E4 01
		 DC 0D 5A 0A
		 D9 17 C9 23
		 6F 44 4D 5A
		 79 00 00 00
		 10 00 00 00
		 00 00 8C C4
		 09 C4 86 CA
		 1D 00 08 00
		 F5 CA AF E4
		 15 FC 05 01
		 C5 07 93 12
		 EB FD 68 32
		 25 06 09 20
		 27 00 14 00
		 12 20 43 05
		 95 0A 3B 06
		 BA 1C 0C 03
		 F5 15 20 12
		 84 18 F0 23
		 C5 4D 83 5B
		 6F 00 00 00
		 0D 00 00 00
		 00 00 90 D5
		 52 CA 89 BB
		 17 00 00 00
		 22 EB AF E4
		 25 FD 5B F2
		 4E E4 0B 0A
		 E8 05 6D 1A
		 9E 33 CC FF
		 07 10 00 00
		 06 0B 99 45
		 17 00 40 00
		 01 02 0A FA
		 FF 00 00 00
		 00 00 00 00
		 00 00 00 00
		 00 00 00 00
		 00 00 00 00
		 00 00 00 00
		 00 00 00 00
		 00 00 00 00
		 00 00 00 00
		 00 00 00 00
		 00 00 00 00
		 00 00 00 00
		 00 00 00 00
		 00 00 00 00
		 00 00 00 00
		 00 00 00 00
		 00 00 00 00
		 00 00 00 00
		 00 00 00 00
	];
};
