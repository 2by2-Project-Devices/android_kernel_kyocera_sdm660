/*
 * This software is contributed or developed by KYOCERA Corporation.
 * (C) 2018 KYOCERA Corporation
 *
 * This program is free software; you can redistribute it and/or modify
 * it under the terms of the GNU General Public License version 2 and
 * only version 2 as published by the Free Software Foundation.
 *
 * This program is distributed in the hope that it will be useful,
 * but WITHOUT ANY WARRANTY; without even the implied warranty of
 * MERCHANTABILITY or FITNESS FOR A PARTICULAR PURPOSE.  See the
 * GNU General Public License for more details.
 */

&rpm_bus {
	rpm-regulator-bobb {
		status = "okay";
		pm660l_bob: regulator-bob {
			regulator-min-microvolt = <3300000>;
			regulator-max-microvolt = <3600000>;
			qcom,pwm-threshold-current = <2000000>;
			qcom,init-bob-mode = <3>;
			status = "okay";
		};
	};
};

