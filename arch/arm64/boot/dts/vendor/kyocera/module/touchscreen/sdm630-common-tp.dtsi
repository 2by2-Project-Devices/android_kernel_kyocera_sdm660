/*
 * This software is contributed or developed by KYOCERA Corporation.
 * (C) 2018 KYOCERA Corporation
 *
 * This program is free software; you can redistribute it and/or modify
 * it under the terms of the GNU General Public License version 2 and
 * only version 2 as published by the Free Software Foundation.
 *
 * This program is distributed in the hope that it will be useful,
 * but WITHOUT ANY WARRANTY; without even the implied warranty of
 * MERCHANTABILITY or FITNESS FOR A PARTICULAR PURPOSE.  See the
 * GNU General Public License for more details.
 */

&i2c_4 { /* BLSP1 QUP4 (TOUCH) */
	status = "okay";
        himax-ts@48 {
		compatible= "himax,hxcommon";
		reg = <0x48>;
		interrupt-parent = <&tlmm>;
		interrupts= <67 0x2>;
		himax,panel-coords = <0 1079 0 2159>;
		himax,display-coords = <0 1080 0 2160>;
		himax,irq-gpio = <&tlmm 67 0x00>;
		himax,rst-gpio = <&tlmm 66 0x00>;
		report_type = <1>;
	};
};
