/* Copyright (c) 2017, The Linux Foundation. All rights reserved.
 *
 * This program is free software; you can redistribute it and/or modify
 * it under the terms of the GNU General Public License version 2 and
 * only version 2 as published by the Free Software Foundation.
 *
 * This program is distributed in the hope that it will be useful,
 * but WITHOUT ANY WARRANTY; without even the implied warranty of
 * MERCHANTABILITY or FITNESS FOR A PARTICULAR PURPOSE.  See the
 * GNU General Public License for more details.
 */
/*
 * This software is contributed or developed by KYOCERA Corporation.
 * (C) 2019 KYOCERA Corporation
 */

/dts-v1/;

#include "../qcom/sdm630.dtsi"
#include "../qcom/sdm630-mtp.dtsi"
#include "../qcom/sdm660-internal-codec.dtsi"
#include "sdm630-CAMELLIA-common.dtsi"
#include "sdm630-TSUBAKI02.dtsi"

/ {
	model = "Qualcomm Technologies, Inc. SDM 630 PM660 + PM660L TSUBAKI02 rev20.";
	compatible = "qcom,sdm630-mtp", "qcom,sdm630", "qcom,mtp", "kc,tsubaki02";
	qcom,board-id = <0x05200005 0>;
	qcom,pmic-id = <0x0001001b 0x0101011a 0x0 0x0>,
			<0x0001001b 0x0201011a 0x0 0x0>;
};
