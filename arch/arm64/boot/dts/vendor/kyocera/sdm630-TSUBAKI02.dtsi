/*
 * This software is contributed or developed by KYOCERA Corporation.
 * (C) 2019 KYOCERA Corporation
 *
 * This program is free software; you can redistribute it and/or modify
 * it under the terms of the GNU General Public License version 2 and
 * only version 2 as published by the Free Software Foundation.
 *
 * This program is distributed in the hope that it will be useful,
 * but WITHOUT ANY WARRANTY; without even the implied warranty of
 * MERCHANTABILITY or FITNESS FOR A PARTICULAR PURPOSE.  See the
 * GNU General Public License for more details.
 */

#include "./module/keys/sdm630-TSUBAKI02-keys.dtsi"
#include "./module/usb/sdm630-TSUBAKI02-usb.dtsi"
#include "./module/pm/charger/sdm630-TSUBAKI02-charger.dtsi"
#include "./module/pm/fg/sdm630-TSUBAKI02-batterydata.dtsi"
#include "./module/pm/fg/sdm630-TSUBAKI02-fg.dtsi"
#include "./module/pm/hkadc/sdm630-TSUBAKI02-hkadc.dtsi"
#include "./module/sensors/sdm630-TSUBAKI02-sensors.dtsi"
#include "./module/audio/sdm630-TSUBAKI02-audio.dtsi"
#include "./module/lights/sdm630-TSUBAKI02-lights.dtsi"
#include "./module/vib/sdm630-TSUBAKI02-vib.dtsi"
#include "./module/product_img/sdm630-TSUBAKI02-product-img.dtsi"
#include "./module/flashdriver/sd/sdm630-TSUBAKI02-sd.dtsi"
