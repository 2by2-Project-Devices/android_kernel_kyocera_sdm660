/* Copyright (c) 2017, The Linux Foundation. All rights reserved.
 *
 * This program is free software; you can redistribute it and/or modify
 * it under the terms of the GNU General Public License version 2 and
 * only version 2 as published by the Free Software Foundation.
 *
 * This program is distributed in the hope that it will be useful,
 * but WITHOUT ANY WARRANTY; without even the implied warranty of
 * MERCHANTABILITY or FITNESS FOR A PARTICULAR PURPOSE.  See the
 * GNU General Public License for more details.
 */
/*
 * This software is contributed or developed by KYOCERA Corporation.
 * (C) 2018 KYOCERA Corporation
 */

/dts-v1/;

#include "../qcom/sdm660.dtsi"
#include "../qcom/sdm660-mtp.dtsi"

#include "sdm630-SAKURA-common.dtsi"
#include "sdm660-TSUBAKI03.dtsi"

#include "./module/flashdriver/sd/sdm660-TSUBAKI03-sd-rev10.dtsi"
#include "./module/pm/gpio/sdm630-TSUBAKI03-rev10-gpio.dtsi"
#include "./module/sensors/sdm660-TSUBAKI03-sensors-rev10.dtsi"

/ {
	model = "Qualcomm Technologies, Inc. SDM 660 PM660 + PM660L TSUBAKI03 rev10.";
	compatible = "qcom,sdm660-mtp", "qcom,sdm660", "qcom,mtp", "kc,tsubaki03";
	qcom,board-id = <0x06100005 0>;
	qcom,pmic-id = <0x0001001b 0x0101011a 0x0 0x0>,
			<0x0001001b 0x0201011a 0x0 0x0>,
			<0x0001001b 0x0102001a 0x0 0x0>;
};
